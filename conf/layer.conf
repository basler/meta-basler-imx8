## conf/layer.conf
```bitbake
# We have a conf and classes directory, add to BBPATH
BBPATH .= ":${LAYERDIR}"

# We have recipes-* directories, add to BBFILES
BBFILES += "${LAYERDIR}/recipes-*/*/*.bb \
         ${LAYERDIR}/recipes-*/*/*.bbappend"

BBFILE_COLLECTIONS += "basler-imx8"
BBFILE_PATTERN_basler-imx8 = "^${LAYERDIR}/"
BBFILE_PRIORITY_basler-imx8 = "50"
LAYERVERSION_basler-imx8 = "1"
LAYERSERIES_COMPAT_basler-imx8 = "kirkstone"

LICENSE_PATH += "${LAYERDIR}/licenses"

# Override/extend machine configurations

# imx8mm-ddr4-evk
KERNEL_DEVICETREE:append:imx8mm-ddr4-evk = " \
  freescale/imx8mm-ddr4-evk-basler-camera.dtb"

# imx8mm-lpddr4-evk
KERNEL_DEVICETREE:append:imx8mm-lpddr4-evk = " \
  freescale/imx8mm-evk-basler-camera.dtb"

# imx8mq-evk
KERNEL_DEVICETREE:append:imx8mq-evk = " \
  freescale/imx8mq-evk-basler-camera-csi1.dtb \
  freescale/imx8mq-evk-basler-camera-csi2.dtb \
  freescale/imx8mq-evk-basler-camera.dtb"

# imx8mp-lpddr4-evk
KERNEL_DEVICETREE:append:imx8mp-lpddr4-evk = " \
  freescale/imx8mp-evk-basler.dtb \
  freescale/imx8mp-evk-dual-basler.dtb \
  freescale/imx8mp-evk-basler-mixed-isp-isi.dtb  \
  freescale/imx8mp-evk-basler-isi0-isi1.dtb  \
  freescale/imx8mp-evk-basler-isi0.dtb "
```
